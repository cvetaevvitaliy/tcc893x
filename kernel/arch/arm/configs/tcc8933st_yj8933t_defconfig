## kernel/drivers/video/tcc/Kconfig
```kconfig
config FB_TCC
	bool "Telechips TCC Frame buffer support"
	depends on FB && (ARCH_TCC92XX || ARCH_TCC88XX || ARCH_TCC93XX || ARCH_TCC892X || ARCH_TCC893X)
	default y
	select FB_CFB_FILLRECT
	select FB_CFB_COPYAREA
	select FB_CFB_IMAGEBLIT

	help
	  Framebuffer driver for Telechips TCC series.

	  If unsure, say N.

config SYNC_FB
	bool "Telechips fb fence sync option"
	depends on SYNC && SW_SYNC && FB
	default y

config TCC_MIPI
	bool "Telelechips MIPI DSI controller"
	default n

config TCC_LCDC_CONTROLLER
	bool "Telechips TCC support LCDC controller"
	depends on FB && (ARCH_TCC92XX || ARCH_TCC88XX || ARCH_TCC93XX)
	default y

	help
	  TCC LCD controller 
	
	  If unsure, say N.

config TCC_VIOC_CONTROLLER
	bool "Telechips TCC support VIOC controller"
	depends on FB && (ARCH_TCC892X || ARCH_TCC893X)
	default y

	help
	  TCC VIOC controller 

	  If unsure, say N.


config FB_TCC_USE_VSYNC_INTERRUPT
	bool "Use VSYNC interrupt"
	depends on FB_TCC && FB_TCC

config HWCOMPOSER_OVER_1_1_FOR_MID
	bool "Support External display device over HWC v1.1 on MID"
	default n
config QUICK_BOOT_LOGO
	bool "FB display device display making snapshot image"
	depends on FB_TCC && HIBERNATION
	default y
	help
		Support for Quick boot.
		During making snapshot image for quickboot, an image (Quickboot logo)
		can be display


config DISPLAY_IMAGE_DURING_QUICKBOOT
	bool "Displaying an image during Quickboot"

choice
        depends on DISPLAY_IMAGE_DURING_QUICKBOOT
        prompt "Please choose one option for display"

config USING_LAST_FRAMEBUFFER
	bool "using last framebuffer"
	help
		support for Quick boot, say Y here if you 
		You can use an image in framebuffer just before making a snapshot boot image 

config USING_IMAGE_WHAT_YOU_WANT
	bool "using an image what you want"
	help	
		support for Quick boot, say Y here if you 
		You can choose any image for agree image

endchoice

config QUICK_BOOT_PROGRESS_BAR
	bool "Display the progress of making snapshot image"
	depends on FB_TCC && HIBERNATION
	default y 
	help
		Supprot for Quick boot.
		During making snapshot image for quickboot, display progress of making snapshot image

config USE_EXT_INTERRUPT
	bool "Use external-vsync-interrupt"
	depends on FB_TCC_USE_VSYNC_INTERRUPT && ARCH_TCC92XX
	default y


config FB_TCC93XX
    bool "TCC93xx Frame buffer support"
	depends on FB && ARCH_TCC93XX
	default y
	select FB_CFB_FILLRECT
	select FB_CFB_COPYAREA
	select FB_CFB_IMAGEBLIT

	help
	  Framebuffer driver for Telechips TCC93xx series.

	  If unsure, say N.

config FB_TCC_OVERLAY
	tristate "Overlay for Camera/Video"
	depends on FB && ARCH_TCC
	help
	  This is the Overlay device driver

config FB_TCC_OVERLAY_EXT
	tristate "Overlay_ext for Camera/Video"
	depends on FB && ARCH_TCC
	help
	  This is the Overlay_ext device driver to support 2-channel overlay.



choice
	prompt "Display Kernel Logo"
	depends on TCC_OUTPUT_ATTACH
	default OUTPUT_DISPLAY_KERNEL_LOGO

config OUTPUT_DISPLAY_KERNEL_LOGO
	bool 'Display Mode'
config OUTPUT_SKIP_KERNEL_LOGO
	bool 'Skip Mode'
endchoice

config TCC_OUTPUT_3D_UI
    bool "Support 3D(SBS/TNB) UI Display for MKV 3D files"
	depends on FB && (MACH_TCC8920ST || MACH_TCC8930ST)
	default n
	help
	  UI will be devided in horizontal/vertical direction according to 3D mode.

config TCC_VIDEO_DISPLAY_BY_VSYNC_INT
    bool "Displaying video frame by hw vsync interrupt"
	depends on FB && (ARCH_TCC93XX || ARCH_TCC88XX || ARCH_TCC892X || ARCH_TCC893X)
	default n
	help
	  Video frame is displayed by hw vsync interrupt.

config TCC_LCD_VIDEO_DISPLAY_BY_VSYNC_INT
    bool "LCD display video by hw vsync interrupt"
	depends on FB && (ARCH_TCC892X || ARCH_TCC893X) && TCC_VIDEO_DISPLAY_BY_VSYNC_INT
	default n
	help
	  It makes LCD use on-the-fly and vsync routine.

config TCC_VIDEO_DISPLAY_DEINTERLACE_MODE
    bool "Support Interlaced Video"
	depends on TCC_VIDEO_DISPLAY_BY_VSYNC_INT
	default y
	help
	  It makes the interlaced video can be displayed smoothly.

config TCC_EXCLUSIVE_UI_LAYER
    bool "Exclusive UI Layer for Specific UI"
	depends on FB && (MACH_TCC9300ST || MACH_TCC8800ST)
	default n
	help
	  Video Frame is displayed with Specific UI data.

config TCC_FB_HIGH_CLOCK
    bool "FB limit clock high"
	depends on FB
	default n
	help
	  FB limit clock chage to high when big size LCD module use.

config VIOC_FIFO_UNDER_RUN_COMPENSATION
		bool "VIOC FIFO-Under-Run Compensation"
		depends on (FB && TCC_VIOC_CONTROLLER)
    help 
    	Reset VIOC display block to compensation the fifo under run problem.

config HDMI_DISPLAY_LASTFRAME
	bool "HDMI use lastframe funtion"
	depends on FB
	default y
	help
	 Using HDMI Last frame funtion for video play

config VIDEO_DISPLAY_SWAP_VPU_FRAME
        bool "Swap frame from vpu on seeking"
        depends on FB
        default y
        help
         To prevent flickering on seeking

menu "Support for LCD panels"

config LCD_LMS350DF01
	bool "Samsung LMS350DF01 LCD support"
	depends on FB_TCC

config LCD_LMS480KF01
	bool "Samsung LMS480KF01 LCD support"
	depends on FB_TCC

config LCD_DX08D11VM0AAA
	bool "Hitachi DX08D11VM0AAA LCD support"
	depends on FB_TCC

config LCD_LB070WV6
	bool "LG PHILIPS LB070WV6 LCD support"
	depends on FB_TCC

config LCD_CLAA104XA01CW
	bool "CPT CLAA104XA01CW LCD support"
	depends on FB_TCC

config LCD_HT121WX2
	bool "Hyundai-BOEhydis HT121WX2 LCD support"
	depends on FB_TCC

config LCD_TD043MGEB1
	bool "TPO TD043MGEB1 LCD support"
	depends on FB_TCC

config LCD_AT070TN93
	bool "INNOLUX AT070TN93 LCD support"
	depends on FB_TCC

config LCD_TD070RDH
	bool "SHANGHAI AVIC OPTOELECTRONICS TD070RDH LCD support"
	depends on FB_TCC


config LCD_HDMI1280X720
	bool "HDMI 1280x720 LCD support"
	depends on FB_TCC

config LCD_HDMI1920X1080
	bool "HDMI 1920X1080 LCD support"
	depends on FB_TCC

config LCD_N101L6
	bool "CHI MED 1024x600 LCD support"
	depends on FB_TCC

config LCD_TW8816
	bool "TW8816 LCD support"
	depends on FB_TCC && (MACH_MOBIS)

config LCD_CLAA102NA0DCW
	bool "CPT 1024 * 600 LVDS support"
	depends on FB_TCC

config LCD_ED090NA
	bool "CHIMEI INNOLUX 1280 * 800 LVDS support"
	depends on FB_TCC

config LCD_KR080PA2S
	bool "EMDOOR 1024 * 768 LVDS support"
        depends on FB_TCC

config LCD_CLAA070NP01
	bool "COBY CHUNGWHA 1024 * 600 LVDS support"
	depends on FB_TCC

config LCD_HV070WSA
	bool "COBY BOE 1024 * 600 LVDS support"
	depends on FB_TCC

config LCD_FLD0800
	bool "1024 * 600 LVDS support"
	depends on FB_TCC

config LCD_CLAA070WP03
	bool "800 * 1280 LVDS support"
	depends on FB_TCC

config LCD_LMS700KF23
	bool "LMS700KF23(800 * 480) Samsung LCD support"
	depends on FB_TCC

config LCD_EJ070NA
	bool "EJ070NA (1024 * 600) CHIMEI LVDS support"
	depends on FB_TCC

config LCD_LP101WX1
	bool "LP101WX1 (1280 * 800) LG LVDS support"
	depends on FB_TCC

config LCD_LCDC0_USE
	bool "platform LCDC is use LCD control 0"
	depends on FB_TCC

endmenu

menu "TCC Extend Display"

config TCC_HDMI_DRIVER_V1_3
	bool "Use TCC HDMI V1.3 drivers"
	depends on (ARCH_TCC892X || CHIP_TCC8935S)
	default y

config TCC_HDMI_DRIVER_V1_4
	bool "Use TCC HDMI V1.4 drivers"
	depends on (ARCH_TCC893X && !CHIP_TCC8935S)
	default y

config TCC_HDMI_VIDEO_UI_DISABLE
	bool "HDMI UI disable during video play"
	depends on (ARCH_TCC88XX && !MACH_TCC8800ST)
	default n

config TCC_OUTPUT_DUAL_UI
    bool "Dual UI for HDMI/Composite/Component Output"
	depends on FB && MACH_TCC8800ST
	default n
	help
	  Video Frame is displayed with Specific UI data.

config EXTEND_DISPLAY_DELAY
	bool "Extend Device Display Delay"
	default n
	help
	 	UI image isn't displyed for few senconds at HDMI detected.
choice
	prompt  "HDMI FB ROTATE DISPLAY"
	depends on (TCC_HDMI_DRIVER_V1_3 || TCC_HDMI_DRIVER_V1_4)
	default HDMI_FB_ROTATE_0

config HDMI_FB_ROTATE_0
	bool 'HDMI FB DISPLAY 0 degree'

config HDMI_FB_ROTATE_90
	bool 'HDMI FB DISPLAY 90 degree'

config HDMI_FB_ROTATE_180
	bool 'HDMI FB DISPLAY 180 degree'

config HDMI_FB_ROTATE_270
	bool 'HDMI FB DISPLAY 270 degree'

endchoice

choice 
	prompt "HDMI Clock select"
	depends on (TCC_HDMI_DRIVER_V1_3 || TCC_HDMI_DRIVER_V1_4)
	default HDMI_CLK_USE_XIN_24MHZ
	
config HDMI_CLK_USE_INTERNAL_PLL
	bool 'HDMI CLK USE INTERNAL PLL'
	
config HDMI_CLK_USE_XIN_24MHZ
	bool 'HDMI CLK USE XIN 24MHZ'

endchoice

config FB_TCC_COMPOSITE
    tristate "Composite(Y+Pb+Pr) Output for UI/Video"
	depends on FB && ARCH_TCC
	help
	  This is the Composite device driver

config FB_TCC_COMPONENT
    tristate "Component(Y/Pb/Pr) Output for UI/Video"
	depends on FB && ARCH_TCC
	help
	  This is the Component device driver

config TCC_VIOC_MANAGER
	bool"VIOC manager select"
	depends on (MACH_TCC8920ST || MACH_TCC8930ST)
	default y
	help
		This is the vioc manager driver

config TCC_COMPOSITE_COLOR_SPACE_YUV
    bool "Change Color Space to YUV for Composite Output"
	depends on FB && (MACH_TCC8920ST || MACH_TCC8930ST)
	default y
	help
	  There is no YUV-to-RGB conversion to enhance signal quality of video data

config TCC_M2M_USE_INTERLACE_OUTPUT
    bool "Use M2M For INTERLACE Output"
        depends on FB && (MACH_TCC8930ST)
        default n
        help
          This is the using of M2M for Interlace output.
	  
config TCC_OUTPUT_AUTO_HDMI_CVBS
    bool "Auto-Detection for HDMI/CVBS Output"
	depends on FB && (MACH_TCC8920ST || MACH_TCC8930ST)
	default n
	help
	  HDMI/CVBS output can be detected automatically.

config TCC_OUTPUT_ATTACH
    bool "Attach Additional Output for Dual Display"
	depends on FB && (MACH_TCC8920ST || MACH_TCC8930ST)
	default n
	help
	  CVBS/Component output can be attached to HDMI output

choice
	prompt "Select Attach Mode"
	depends on TCC_OUTPUT_ATTACH
	default TCC_OUTPUT_ATTACH_HDMI_CVBS

config TCC_OUTPUT_ATTACH_HDMI_CVBS
	bool 'HDMI/CVBS Mode'
config TCC_OUTPUT_ATTACH_DUAL_AUTO
	bool 'Auto Dual Mode'
endchoice

config TCC8925S_DISP_PORT_CHANGE
	bool "TCC8925S port changed for HDMI display"
	depends on CHIP_TCC8925S && TCC_HDMI_DRIVER_V1_3 
	default n
	help
	   special function for TCC8925S HDMI display

endmenu	
```
