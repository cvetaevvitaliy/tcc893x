## kernel/arch/arm/mach-tcc893x/Kconfig
```kconfig
if ARCH_TCC893X

comment "Machine Features"

choice
	prompt "TCC893x Chipset Type"
	default CHIP_TCC8930
	depends on ARCH_TCC893X
	help
	  Select TCC893x Chipset type.

config CHIP_TCC8930
	bool "TCC8930 Chipset"
	select HAVE_SMP
	select PM_GENERIC_DOMAINS
	select DRAM_32BIT_USED
	help
	  Support for the TCC8930 Chipset. Say Y here if you
	  have such a device.

config CHIP_TCC8933
	bool "TCC8933 Chipset"
	select HAVE_SMP
	select PM_GENERIC_DOMAINS
	select DRAM_32BIT_USED
	help
	  Support for the TCC8933 Chipset. Say Y here if you
	  have such a device.

config CHIP_TCC8935
	bool "TCC8935 Chipset"
	select HAVE_SMP
	select PM_GENERIC_DOMAINS
	select DRAM_16BIT_USED
	help
	  Support for the TCC8935 Chipset. Say Y here if you
	  have such a device.

config CHIP_TCC8933S
	bool "TCC8933S Chipset"
	select HAVE_SMP
	select PM_GENERIC_DOMAINS
	select DRAM_32BIT_USED
	help
	  Support for the TCC8933S Chipset. Say Y here if you
	  have such a device.

config CHIP_TCC8935S
	bool "TCC8935S Chipset"
	select HAVE_SMP
	select PM_GENERIC_DOMAINS
	select DRAM_16BIT_USED
	help
	  Support for the TCC8935S Chipset. Say Y here if you
	  have such a device.

config CHIP_TCC8937S
	bool "TCC8937S Chipset"
	select HAVE_SMP
	select PM_GENERIC_DOMAINS
	select DRAM_32BIT_USED
	help
	  Support for the TCC8937S Chipset. Say Y here if you
	  have such a device.

endchoice

choice
	prompt "TCC893x Board(Machine) Type"
	default MACH_TCC893X
	depends on ARCH_TCC893X
	help
	  Select TCC893x board type.

config MACH_TCC893X
	bool "TCC8930 evaluation board"
	help
	  Support for the TCC8930 evaluation board. Say Y here if you
	  have such a device.

config MACH_TCC8930ST
	bool "TCC8930 STB evaluation board"
	help
	  Support for the TCC8930 STB evaluation board. Say Y here if you
	  have such a device.

config MACH_M805_893X
	bool "M805_TCC893x board"
	help
	  Support for the TCC893x M805 board. Say Y here if you
	  have such a device.
endchoice

choice
	prompt "TCC893x STB Board"
	default STB_BOARD_EV_TCC893X
	depends on MACH_TCC8930ST
	help
	  Select TCC893x STB Board Type.

config STB_BOARD_EV_TCC893X
	bool "TCC8930 STB EV board"
	depends on MACH_TCC8930ST
	help
	  Support for TCC8930 STB Base Board.

config STB_BOARD_YJ8930T
	bool "TCC8930 YJ8930T board"
	depends on MACH_TCC8930ST
	help
	  Support for TCC8930 YJ8930T Board.

config STB_BOARD_YJ8933T
	bool "TCC8933 YJ8933T board"
	depends on MACH_TCC8930ST
	help
	  Support for TCC8933 YJ8933T Board.

config STB_BOARD_YJ8935T
	bool "TCC8935 YJ8935T board"
	depends on MACH_TCC8930ST
	help
	  Support for TCC8935 YJ8935T Board.

config STB_BOARD_DONGLE_TCC893X
	bool "TCC8935 HDMI dongle board"
	depends on MACH_TCC8930ST
	help
	  Support for TCC8935 HDMI Dongle Board.

config STB_BOARD_UPC_TCC893X
        bool "TCC8935 uPC board"
        depends on MACH_TCC8930ST
        help
          Support for TCC8935 UPC Board.
endchoice

choice
	prompt "TCC893x HDMI Dongle WiFi Chip"
	default HDMI_DONGLE_WIFI_REALTEK_TCC893x
	depends on STB_BOARD_DONGLE_TCC893X
	help
	  Select WiFi Chip of TCC8935 HDMI Dongle Board.

config HDMI_DONGLE_WIFI_REALTEK_TCC893x
	bool "Realtek RTL8188/8189"
	depends on STB_BOARD_DONGLE_TCC893X
	help
	  Support Realtek RTL8188/8189 for TCC8935 HDMI Dongle Board.
endchoice

config GPIO_CORE_VOLTAGE_CONTROL
        bool "Ctrl cpu voltage A/B voltage by gpio ports"
        depends on MACH_TCC8930ST
        help
          Support for the TCC8930 STB Board.


config TCC_OUTPUT_STARTER
        bool "TCC OUTPUT show boot logo image on HDMI/CVBS/Component"
        depends on (ARCH_TCC893X || MACH_TCC8930ST)
        default n
        help
          Support for the TCC893x STB board, Say Y here if you want
          to show boot logo by using HDMI/CVBS/Component output

config CLOCK_TABLE
	bool "Clock Table"
	depends on (ARCH_TCC893X) && (DRAM_16BIT_USED) && !(MACH_TCC8930ST) && !(ARM_TRUSTZONE)
	select AUTO_HOTPLUG
	default y

config AUTO_HOTPLUG
	bool "Auto Hotplug"
	depends on (ARCH_TCC893X) && (CLOCK_TABLE)
	default n

config IOBUS_DFS
	bool "I/O(HS I/O) Bus DFS"
	depends on (ARCH_TCC893X) && !(CLOCK_TABLE)
	default n

config AUDIO_PLL_USE
	bool "Audio PLL use"
	depends on (CHIP_TCC8930 || CHIP_TCC8933 || CHIP_TCC8935) && ARCH_TCC893X
	default y

config TCC_CPUFREQ_HIGHSPEED_CLOCK
	int "Rate of Highspeed CPU clock (850 ~ 1000, 1200)MHz (1200MHz is for test)"
	range 850 1200
	depends on ARCH_TCC893X
	default "1000"

config HIGHSPEED_TIME_LIMIT
	bool "HighSpeed Time Limit"
	depends on ARCH_TCC893X
	default n

config HIGHSPEED_HIGHSPEED_TIME
	int "Time(sec) of Highspeed CPU clock (1-30)"
	range 1 30
	depends on HIGHSPEED_TIME_LIMIT
	default "5"

config HIGHSPEED_LIMITED_TIME
	int "Time(sec) of Limited CPU clock (1-30)"
	range 1 30
	depends on HIGHSPEED_TIME_LIMIT
	default "15"

config HIGHSPEED_LIMITED_CLOCK
	int "Rate of Time Limited CPU clock (524 ~ 1000)MHz"
	range 524 1000
	depends on HIGHSPEED_TIME_LIMIT
	default "1000"

endif
```

## kernel/arch/arm/plat-tcc/Kconfig
```kconfig
if ARCH_TCC

choice
	prompt "TCC Processor Family"

config ARCH_TCC892X
	bool "TCC892x"
	select AEABI
	select CPU_V7
	select VFP
	select NEON
	select CACHE_L2X0

config ARCH_TCC893X
	bool "TCC893x"
	select AEABI
	select CPU_V7
	select VFP
	select NEON
	select CACHE_L2X0
	select ARM_GIC
	select LOCAL_TIMERS if SMP
	select MALI400

endchoice


comment "Platform Features"

config MEM_CLK_SYNC_MODE
	bool "Memory clock Synchronous mode"
	depends on ARCH_TCC93XX
	default n
	help
	  It's used for generating memory bus clock
	  in synchronous clock mode.

choice
	prompt "DRAM Memory Type"
	default DRAM_DDR2
	help
	  Select DRAM Type.

config DRAM_MDDR
	bool "DRAM mDDR(LPDDR)"

config DRAM_LPDDR2
	bool "DRAM LPDDR2"

config DRAM_DDR2
	bool "DRAM DDR2"

config DRAM_DDR3
	bool "DRAM DDR3"

endchoice

choice
	bool "DRAM Memory Size"
	default TCC_MEM_1024MB
	help
	  System memory size.

config TCC_MEM_2048MB
	bool "2048MB"

config TCC_MEM_1024MB
	bool "1024MB"

config TCC_MEM_512MB
	bool "512MB"

config TCC_MEM_256MB
	bool "256MB"

config TCC_MEM_128MB
	bool "128MB"

endchoice

choice
        bool "DRAM Memory Extra DQS Delay cycle"
        default TCC_MEM_EXTRA_DQSDC_NON
        depends on CHIP_TCC8935 || CHIP_TCC8935S
        help
          Dram DQS delay cycle.

config TCC_MEM_EXTRA_DQSDC_NON
        bool "Non DQS Delay cycle"

config TCC_MEM_EXTRA_DQSDC_1
        bool "DQS Delay 1 cycle"

config TCC_MEM_EXTRA_DQSDC_2
        bool "DQS Delay 2 cycle"

endchoice

config DRAM_16BIT_USED
	tristate

config DRAM_32BIT_USED
	tristate

config DRAM_AUTO_TRAINING
	bool "DRAM Auto Training during wake up"
	depends on DRAM_32BIT_USED && DRAM_DDR3 && ARCH_TCC893X
	default y
	help
	  Enable dram auto training when wake up


config ROTATION_WITH180
	depends on DRAM_16BIT_USED
	bool "Enable LCD 180 rotation regardless of DRAM bandwidth "
        default y

choice
  bool "mDDR (LPDDR) settings"
  depends on DRAM_MDDR
  default MDDR_H5MS1G62MFP

config MDDR_H5MS1G62MFP
  bool "Hynix H5MS1G62MFP (166MHz)"

config MDDR_K4X1G163PE
  bool "Samsung K4X1G163PE (200MHz)"

config MDDR_EHD013091MA60
  bool "ELPIDA EHD013091MA-60 (166MHz)"

config MDDR_MT46H64M32LF
  bool "MICRON MT46H64M32LF (166MHz)"

endchoice

choice
  bool "LPDDR2 settings"
  depends on DRAM_LPDDR2
  default LPDDR2_K4P4G324EB_AGC1

config LPDDR2_K4P4G324EB_AGC1
  depends on TCC_MEM_512MB
  bool "SAMSUNG K4P4G324EB AGC1"

endchoice

choice
  bool "DDR2 settings"
  depends on DRAM_DDR2
  default DDR2_HXB18T2G160AF

config DDR2_K4T1G164QQ
  bool "Samsung K4T1G164QQ"

config DDR2_K4T1G164QF_BCE7
  bool "Samsung K4T1G164QF-BCE7"

config DDR2_HY5PS1G1631CFPS6
  bool "Hynix HY5PS1G1631C FP-S6"

config DDR2_HY5PS1G831CFPS6
  bool "Hynix HY5PS1G831C FP-S6"

config DDR2_HXB18T2G160AF
  bool "SCSemicon HXB18T2G160AF-25D"

config DDR2_E1108AEBG
  bool "ELPIDA E1108AEBG"

config DDR2_E2116ABSE
  bool "ELPIDA E2116ABSE"

config DDR2_MT47H128M8
  bool "Micron MT47H128M8"

config DDR2_K4T1G164QE_HCF7
  bool "Samsung K4T1G164QE-HCF7"

config DDR2_K4T1G084QF_BCE7
  bool "Samsung K4T1G084QF-BCE7"

config DDR2_CT83486C1
  bool "Chipsip CT83486C1"

config DDR2_MT47H256M8EB25E
  depends on TCC_MEM_1024MB
  bool "Micron MT47H256M8EB-25E"

endchoice

choice
  bool "DDR3 settings"
  depends on DRAM_DDR3
  default DDR3_K4B1G1646E_HCH9

config DDR3_K4B2G1646C_HCK0
  bool "Samsung K4B2G1646C-HCK0"

config DDR3_K4B1G1646E_HCH9
  bool "Samsung K4B1G1646E-HCH9"

config DDR3_H5TQ2G63BFR_H9C
  bool "Hynix DDR3_H5TQ2G63BFR-H9C"

config DDR3_H5TQ2G63BFR_PBC
  bool "Hynix DDR3_H5TQ2G63BFR-PBC"

config DDR3_H5TQ1G83BFR_H9C
  bool "Hynix DDR3_H5TQ1G83BFR_H9C"

config DDR3_H5TQ2G83BFR_H9C
  bool "Hynix DDR3_H5TQ2G83BFR_H9C"

config DDR3_H5TQ2G83BFR_PBC
  bool "Hynix DDR3_H5TQ2G83BFR_PBC"

config DDR3_IN5CB256M8BN_CG
  bool "Innoways IN5CB256M8BN_CG"

config DDR3_NT5CB256M8GN_CG
  bool "Nanya NT5CB256M8GN_CG"

config DDR3_PRN256M8V89CG8GQF_15E
  bool "SpecTek PRN256M8V89CG8GQF_15E"

config DDR3_H5TC4G83MFR_H9A
  bool "Hynix DDR3_H5TC4G83MFR_H9A"

config DDR3_H5TQ4G83AFR_PBC
  bool "Hynix DDR3_H5TQ4G83AFR_PBC"

config DDR3_W632GG8KB_12
  bool "Winbond DDR3_W632GG8KB_12"

endchoice

config SUSPEND_MEMCLK
	bool
	default y
	depends on ARCH_TCC893X
	help
	  Decrease the memory clock when system into the suspend

config TCC_ECID_SUPPORT
	bool "TCC ECID(CPU ID) SUPPORT"
        default n
	help
	  Support for the TCCXXXX demo board, Say Y here if you use ECID

endif
```

## kernel/drivers/gpu/ion/Kconfig
```kconfig
menuconfig ION
	tristate "Ion Memory Manager"
	select GENERIC_ALLOCATOR
	select DMA_SHARED_BUFFER
	default n
	help
	  Chose this option to enable the ION Memory Manager.

config ION_TCC
	tristate "Ion for TCC"
	depends on ION
	default y
	help
	  Choose this option if you wish to use ion on a Telechips board.
```

## kernel/drivers/gpu/mali/Kconfig
```kconfig
config MALI_GPU
	tristate "Mali GPU device driver"
	depends on FB && ARM
	---help---
	  Device driver for ARM Mali-200 and Mali-400 GPUs.

config MALI400
	bool
	depends on MALI_GPU

config GPU_BUS_SCALING
	bool "Use GPU bus scaling"
	default n
	depends on MALI_GPU
	---help---
	   Use GPU bus scaling for Mali GPU

config MALI_OS_MEMORY
	bool "Use OS memory"
	default y
	depends on MALI_GPU
	---help---
	   Use OS memory for Mali GPU

config MALI_MEMORY_SIZE
	int "Mali memory size"
	default 512 if TCC_MEM_1024MB
	default 300 if TCC_MEM_512MB
	depends on MALI_GPU
	----help---
	    Memory size for Mali GPU

config MALI400_PROFILING
	bool "Enable Mali profiling"
	depends on MALI400
	select TRACEPOINTS
	default y
	---help---
	  This enables gator profiling of Mali GPU events.

config MALI400_INTERNAL_PROFILING
	bool "Enable internal Mali profiling API"
	depends on MALI400_PROFILING
	default n
	---help---
	  This enables the internal legacy Mali profiling API.

config MALI_UMP
	tristate "UMP device driver"
	depends on MALI_GPU
	default y
	---help---
	  Device driver for ARM Unified Memory Provider (UMP).

config UMP_OS_MEMORY
	bool "Use OS memory"
	default y
	depends on MALI_UMP
	---help---
	   Use OS memory for UMP

config UMP_MEMORY_ADDRESS
	int "UMP memory address"
	default 0
	depends on MALI_UMP
	---help---
	   Memory address for UMP

config UMP_MEMORY_SIZE
	int "UMP memory size"
	default 72
	depends on MALI_UMP
	---help---
	   Memory size for UMP in MB
```

## kernel/drivers/media/video/tcccam/hdmi_in/Kconfig
```kconfig
config VIDEO_TCCXX_HDMI_IN
	tristate "Telechips TCCXXX HDMI IN support (EXPERIMENTAL)"
	select VIDEOBUF_GEN
	select VIDEOBUF_DMA_SG
	select VIDEOBUF_VMALLOC
	depends on VIDEO_DEV
	help
	  V4L2 Analog HDMI IN driver support for TCCXXX.
	
config VIDEO_HDMI_IN_SENSOR
	tristate "HDMI_IN sensor support"
	depends on VIDEO_TCCXX_HDMI_IN
	help
	   atv sensor support

config VIDEO_HDMI_IN_SENSOR_EP9553T
	tristate "EP9553T HDMI_IN sensor support"
	depends on VIDEO_HDMI_IN_SENSOR
	help
	   atv sensor support for EP9553T













































 
```

## kernel/drivers/net/ethernet/tcc_gmac/Kconfig
```kconfig
#
#Telechips
#
config TCC_GMAC
	tristate "Telechips 10/100/1000 Ethernet Driver"
	depends on ARCH_TCC88XX || ARCH_TCC93XX || ARCH_TCC892X || ARCH_TCC893X
	select CRC32
	select MII 
	---help---
	  Support for Telechips 10/100/1000 Ethernet Driver

config TCC_GMAC_DA
    bool "Rx has priority over Tx"
    depends on TCC_GMAC
    default y

choice
    prompt "Phy Interface"
    depends on TCC_GMAC
    default TCC_GMAC_RGMII_MODE
    help 
        Select TCC_GMAC Phy Interface Mode
config TCC_GMAC_MII_MODE
    bool "MII"
    help 
        Select MII Phy Interface Mode
config TCC_GMAC_RMII_MODE
    bool "RMII"
    help 
        Select RMII Phy Interface Mode
config TCC_GMAC_GMII_MODE
    bool "GMII"
    help 
        Select GMII Phy Interface Mode
config TCC_GMAC_RGMII_MODE
    bool "RGMII"
    help 
        Select RGMII Phy Interface Mode
endchoice

config TCC_GMAC_SET_MAC_FROM_CHIP
    bool "Mac address is set by reading TCC Chip ID"
    depends on TCC_GMAC
    default n

config TCC_GMAC_FQTSS_SUPPORT
    bool "Support FQTSS(IEEE 802.1Qav)"
	help
    	Support Forwaring and Queuing Enhancements for Time-Sensitive Streams(IEEE 802.1Qav)
    depends on TCC_GMAC
    default n

config TCC_GMAC_PTP
    bool "Support PTP(IEEE 1588-2008)"
	select PPS
	select NETWORK_PHY_TIMESTAMPING
	select PTP_1588_CLOCK
	help
    	Support Precision Time Protocol(IEEE 1588-2008)
    depends on TCC_GMAC
    default n
```

## kernel/drivers/power/tcc_power/Kconfig
```kconfig
menuconfig TCC_CHARGER
	bool "TCC Series Charger drivers"
	select CHARGER
	default n
	---help---
	  This option allows you to select X-Powers TCC power driver

if TCC_CHARGER





endif # !KP_TCC
```
