## kernel/arch/arm/configs/tcc8933st_yj8933t_defconfig
```kconfig
# CONFIG_ARM_PATCH_PHYS_VIRT is not set
CONFIG_EXPERIMENTAL=y
# CONFIG_LOCALVERSION_AUTO is not set
# CONFIG_SWAP is not set
CONFIG_SYSVIPC=y
CONFIG_AUDIT=y
CONFIG_IKCONFIG=y
CONFIG_IKCONFIG_PROC=y
CONFIG_CGROUPS=y
CONFIG_CGROUP_DEBUG=y
CONFIG_CGROUP_FREEZER=y
CONFIG_CGROUP_CPUACCT=y
CONFIG_RESOURCE_COUNTERS=y
CONFIG_CGROUP_SCHED=y
CONFIG_RT_GROUP_SCHED=y
CONFIG_BLK_DEV_INITRD=y
CONFIG_CC_OPTIMIZE_FOR_SIZE=y
CONFIG_PANIC_TIMEOUT=5
CONFIG_KALLSYMS_ALL=y
CONFIG_EMBEDDED=y
# CONFIG_SLUB_DEBUG is not set
CONFIG_MODULES=y
CONFIG_MODULE_UNLOAD=y
CONFIG_MODULE_FORCE_UNLOAD=y
# CONFIG_BLK_DEV_BSG is not set
CONFIG_PARTITION_ADVANCED=y
CONFIG_EFI_PARTITION=y
# CONFIG_IOSCHED_DEADLINE is not set
# CONFIG_IOSCHED_CFQ is not set
CONFIG_ARCH_TCC=y
CONFIG_GPIO_PCA953X=y
CONFIG_CHIP_TCC8933=y
CONFIG_MACH_TCC8930ST=y
CONFIG_STB_BOARD_YJ8933T=y
CONFIG_GPIO_CORE_VOLTAGE_CONTROL=y
CONFIG_TCC_OUTPUT_STARTER=y
CONFIG_TCC_CPUFREQ_HIGHSPEED_CLOCK=1000
CONFIG_ARCH_TCC893X=y
CONFIG_DRAM_DDR3=y
CONFIG_DRAM_32BIT_USED=y
CONFIG_DDR3_H5TQ2G83BFR_PBC=y
CONFIG_ARM_THUMBEE=y
# CONFIG_SWP_EMULATE is not set
CONFIG_ARM_ERRATA_742231=y
CONFIG_ARM_ERRATA_751472=y
CONFIG_ARM_ERRATA_754322=y
CONFIG_ARM_ERRATA_764369=y
CONFIG_PL310_ERRATA_769419=y
CONFIG_NO_HZ=y
CONFIG_HIGH_RES_TIMERS=y
CONFIG_SMP=y
CONFIG_NR_CPUS=2
CONFIG_PREEMPT=y
# CONFIG_OABI_COMPAT is not set
CONFIG_HIGHMEM=y
CONFIG_KSM=y
CONFIG_DEFAULT_MMAP_MIN_ADDR=32768
CONFIG_CMDLINE="vmalloc=480M"
CONFIG_CMDLINE_EXTEND=y
CONFIG_CPU_FREQ=y
CONFIG_CPU_FREQ_DEFAULT_GOV_INTERACTIVE=y
CONFIG_CPU_FREQ_GOV_PERFORMANCE=y
CONFIG_CPU_FREQ_GOV_ONDEMAND=y
# CONFIG_CORE_DUMP_DEFAULT_ELF_HEADERS is not set
CONFIG_PM_AUTOSLEEP=y
CONFIG_PM_WAKELOCKS=y
CONFIG_PM_RUNTIME=y
CONFIG_NET=y
CONFIG_PACKET=y
CONFIG_UNIX=y
CONFIG_NET_KEY=y
CONFIG_INET=y
CONFIG_IP_MULTICAST=y
CONFIG_IP_PNP=y
CONFIG_IP_PNP_DHCP=y
CONFIG_IP_PNP_BOOTP=y
CONFIG_IP_PNP_RARP=y
CONFIG_INET_ESP=y
# CONFIG_INET_XFRM_MODE_TUNNEL is not set
# CONFIG_INET_XFRM_MODE_BEET is not set
# CONFIG_INET_LRO is not set
CONFIG_IPV6=y
CONFIG_IPV6_PRIVACY=y
CONFIG_IPV6_ROUTER_PREF=y
CONFIG_IPV6_ROUTE_INFO=y
CONFIG_IPV6_OPTIMISTIC_DAD=y
CONFIG_INET6_AH=y
CONFIG_INET6_ESP=y
CONFIG_INET6_IPCOMP=y
CONFIG_IPV6_MIP6=y
CONFIG_IPV6_TUNNEL=y
CONFIG_IPV6_MULTIPLE_TABLES=y
CONFIG_IPV6_SUBTREES=y
CONFIG_NETFILTER=y
CONFIG_NF_CONNTRACK=y
CONFIG_NF_CONNTRACK_EVENTS=y
CONFIG_NF_CT_PROTO_DCCP=y
CONFIG_NF_CT_PROTO_SCTP=y
CONFIG_NF_CT_PROTO_UDPLITE=y
CONFIG_NF_CONNTRACK_AMANDA=y
CONFIG_NF_CONNTRACK_FTP=y
CONFIG_NF_CONNTRACK_H323=y
CONFIG_NF_CONNTRACK_IRC=y
CONFIG_NF_CONNTRACK_NETBIOS_NS=y
CONFIG_NF_CONNTRACK_PPTP=y
CONFIG_NF_CONNTRACK_SANE=y
CONFIG_NF_CONNTRACK_SIP=y
CONFIG_NF_CONNTRACK_TFTP=y
CONFIG_NF_CT_NETLINK=y
CONFIG_NETFILTER_TPROXY=y
CONFIG_NETFILTER_XT_TARGET_CLASSIFY=y
CONFIG_NETFILTER_XT_TARGET_CONNMARK=y
CONFIG_NETFILTER_XT_TARGET_LED=y
CONFIG_NETFILTER_XT_TARGET_MARK=y
CONFIG_NETFILTER_XT_TARGET_NFLOG=y
CONFIG_NETFILTER_XT_TARGET_NFQUEUE=y
CONFIG_NETFILTER_XT_MATCH_COMMENT=y
CONFIG_NETFILTER_XT_MATCH_CONNLIMIT=y
CONFIG_NETFILTER_XT_MATCH_CONNMARK=y
CONFIG_NETFILTER_XT_MATCH_CONNTRACK=y
CONFIG_NETFILTER_XT_MATCH_HELPER=y
CONFIG_NETFILTER_XT_MATCH_IPRANGE=y
CONFIG_NETFILTER_XT_MATCH_LENGTH=y
CONFIG_NETFILTER_XT_MATCH_LIMIT=y
CONFIG_NETFILTER_XT_MATCH_MAC=y
CONFIG_NETFILTER_XT_MATCH_MARK=y
CONFIG_NETFILTER_XT_MATCH_MULTIPORT=y
CONFIG_NETFILTER_XT_MATCH_POLICY=y
CONFIG_NETFILTER_XT_MATCH_PKTTYPE=y
CONFIG_NETFILTER_XT_MATCH_QTAGUID=y
CONFIG_NETFILTER_XT_MATCH_QUOTA=y
CONFIG_NETFILTER_XT_MATCH_QUOTA2=y
CONFIG_NETFILTER_XT_MATCH_QUOTA2_LOG=y
CONFIG_NETFILTER_XT_MATCH_SOCKET=y
CONFIG_NETFILTER_XT_MATCH_STATE=y
CONFIG_NETFILTER_XT_MATCH_STATISTIC=y
CONFIG_NETFILTER_XT_MATCH_STRING=y
CONFIG_NETFILTER_XT_MATCH_TIME=y
CONFIG_NETFILTER_XT_MATCH_U32=y
CONFIG_NF_CONNTRACK_IPV4=y
CONFIG_IP_NF_IPTABLES=y
CONFIG_IP_NF_MATCH_AH=y
CONFIG_IP_NF_MATCH_ECN=y
CONFIG_IP_NF_MATCH_TTL=y
CONFIG_IP_NF_FILTER=y
CONFIG_IP_NF_TARGET_REJECT=y
CONFIG_NF_NAT=y
CONFIG_IP_NF_TARGET_MASQUERADE=y
CONFIG_IP_NF_TARGET_NETMAP=y
CONFIG_IP_NF_TARGET_REDIRECT=y
CONFIG_IP_NF_MANGLE=y
CONFIG_IP_NF_ARPTABLES=y
CONFIG_IP_NF_ARPFILTER=y
CONFIG_IP_NF_ARP_MANGLE=y
CONFIG_IP6_NF_IPTABLES=y
CONFIG_IP6_NF_FILTER=y
CONFIG_IP6_NF_MANGLE=y
CONFIG_NET_SCHED=y
CONFIG_NET_SCH_HTB=y
CONFIG_BT=y
CONFIG_BT_RFCOMM=y
CONFIG_BT_RFCOMM_TTY=y
CONFIG_BT_BNEP=y
CONFIG_BT_HIDP=y
CONFIG_BT_HCIUART=y
CONFIG_BT_HCIUART_H4=y
CONFIG_BT_HCIUART_BCSP=y
CONFIG_BT_HCIUART_ATH3K=y
CONFIG_CFG80211=y
CONFIG_NL80211_TESTMODE=y
CONFIG_CFG80211_ALLOW_RECONNECT=y
CONFIG_RFKILL=y
CONFIG_NFC=y
CONFIG_UEVENT_HELPER_PATH="/sbin/hotplug"
CONFIG_BLK_DEV_LOOP=y
CONFIG_MISC_DEVICES=y
CONFIG_UID_STAT=y
CONFIG_SCSI=y
CONFIG_BLK_DEV_SD=y
CONFIG_CHR_DEV_SG=y
CONFIG_SCSI_MULTI_LUN=y
CONFIG_MD=y
CONFIG_BLK_DEV_DM=y
CONFIG_DM_DEBUG=y
CONFIG_DM_CRYPT=y
CONFIG_DM_UEVENT=y
CONFIG_NETDEVICES=y
CONFIG_DUMMY=y
CONFIG_TUN=y
CONFIG_PHYLIB=y
CONFIG_TCC_REALTEK_PHY=y
CONFIG_TCC_GMAC=y
# CONFIG_NETDEV_10000 is not set
CONFIG_PPP=y
CONFIG_PPP_BSDCOMP=y
CONFIG_PPP_DEFLATE=y
CONFIG_PPP_MPPE=y
CONFIG_PPPOLAC=y
CONFIG_PPPOPNS=y
CONFIG_PPP_ASYNC=y
CONFIG_INPUT_POLLDEV=y
# CONFIG_INPUT_MOUSEDEV is not set
CONFIG_INPUT_EVDEV=y
CONFIG_INPUT_KEYRESET=y
# CONFIG_KEYBOARD_ATKBD is not set
# CONFIG_INPUT_MOUSE is not set
CONFIG_INPUT_MISC=y
CONFIG_INPUT_KEYCHORD=y
CONFIG_INPUT_TCC_REMOTE=y
CONFIG_YAOJIN_IR=y
CONFIG_INPUT_UINPUT=y
CONFIG_INPUT_GPIO=y
# CONFIG_SERIO is not set
# CONFIG_CONSOLE_TRANSLATIONS is not set
# CONFIG_VT_CONSOLE is not set
# CONFIG_LEGACY_PTYS is not set
# CONFIG_DEVKMEM is not set
CONFIG_SERIAL_TCC=y
CONFIG_SERIAL_TCC_CONSOLE=y
CONFIG_TTY_PRINTK=y
# CONFIG_HW_RANDOM is not set
# CONFIG_TCC_SENSOR_DRV is not set
CONFIG_TCC_USER_INTR=y
# CONFIG_TCC_BT_DEV is not set
CONFIG_I2C=y
CONFIG_I2C_CHARDEV=y
CONFIG_SPI=y
CONFIG_SPI_TCCXXXX_MASTER=y
CONFIG_SPI_TCCXXXX_TSIF_SLAVE=y
CONFIG_SPI_SPIDEV=y
CONFIG_POWER_SUPPLY=y
CONFIG_BATTERY_TCC=y
# CONFIG_HWMON is not set
CONFIG_MEDIA_SUPPORT=y
CONFIG_VIDEO_DEV=y
CONFIG_DVB_CORE=y
# CONFIG_RC_CORE is not set
# CONFIG_MEDIA_TUNER_CUSTOMISE is not set
CONFIG_VIDEO_HELPER_CHIPS_AUTO=y
# CONFIG_RADIO_ADAPTERS is not set
CONFIG_MALI_GPU=y
CONFIG_VIDEO_OUTPUT_CONTROL=y
CONFIG_FB=y
CONFIG_FB_TCC_USE_VSYNC_INTERRUPT=y
CONFIG_FB_TCC_OVERLAY=y
CONFIG_FB_TCC_OVERLAY_EXT=y
CONFIG_TCC_VIDEO_DISPLAY_BY_VSYNC_INT=y
CONFIG_VIOC_FIFO_UNDER_RUN_COMPENSATION=y
CONFIG_HDMI_DISPLAY_LASTFRAME=y
CONFIG_LCD_HDMI1280X720=y
CONFIG_FB_TCC_COMPOSITE=y
CONFIG_TCC_M2M_USE_INTERLACE_OUTPUT=y
CONFIG_SOUND=y
CONFIG_SND=y
# CONFIG_SND_SUPPORT_OLD_API is not set
CONFIG_SND_SOC=y
CONFIG_SND_SOC_TCC=y
CONFIG_SND_SOC_TCC_BOARD_WM8524=y
CONFIG_SND_SOC_TCC_MULTICHANNEL=y
CONFIG_USB=y
CONFIG_USB_SUSPEND=y
CONFIG_TCC_USB_DRD=y
CONFIG_USB_DWC3=m
CONFIG_USB_XHCI_HCD=m
CONFIG_USB_XHCI_TCC=y
CONFIG_USB_XHCI_SS_MODE=y
CONFIG_USB_EHCI_HCD=y
CONFIG_USB_EHCI_ROOT_HUB_TT=y
CONFIG_USB_EHCI_TT_NEWSCHED=y
CONFIG_USB_EHCI_TCC=y
CONFIG_USB_OHCI_HCD=y
CONFIG_USB_STORAGE=y
CONFIG_USB_GADGET=m
CONFIG_USB_G_ANDROID=m
CONFIG_USB_G_ANDROID_ADB=y
CONFIG_USB_G_ANDROID_MASS_STORAGE=y
CONFIG_USB_G_ANDROID_MTP=y
CONFIG_USB_G_ANDROID_ACCESSORY=y
CONFIG_MMC=y
CONFIG_MMC_UNSAFE_RESUME=y
CONFIG_MMC_EMBEDDED_SDIO=y
CONFIG_MMC_PARANOID_SD_INIT=y
CONFIG_MMC_BLOCK_MINORS=16
CONFIG_MMC_TCC893X_SDHC=y
CONFIG_MMC_TCC_SDHC0=y
CONFIG_MMC_TCC_SDHC1=y
CONFIG_NEW_LEDS=y
CONFIG_LEDS_CLASS=y
CONFIG_LEDS_GPIO=y
CONFIG_LEDS_TRIGGERS=y
CONFIG_LEDS_TRIGGER_TIMER=y
CONFIG_LEDS_TRIGGER_HEARTBEAT=y
CONFIG_SWITCH=y
CONFIG_SWITCH_GPIO=y
CONFIG_RTC_CLASS=y
# CONFIG_RTC_INTF_SYSFS is not set
# CONFIG_RTC_INTF_PROC is not set
CONFIG_RTC_DRV_TCC8930=y
CONFIG_STAGING=y
CONFIG_ANDROID=y
CONFIG_ANDROID_BINDER_IPC=y
CONFIG_ASHMEM=y
CONFIG_ANDROID_LOGGER=y
CONFIG_ANDROID_RAM_CONSOLE=y
CONFIG_ANDROID_TIMED_GPIO=y
CONFIG_ANDROID_LOW_MEMORY_KILLER=y
CONFIG_ANDROID_INTF_ALARM_DEV=y
CONFIG_EXT2_FS=y
CONFIG_EXT2_FS_XATTR=y
CONFIG_EXT2_FS_POSIX_ACL=y
CONFIG_EXT2_FS_SECURITY=y
CONFIG_EXT4_FS=y
CONFIG_EXT4_FS_SECURITY=y
# CONFIG_DNOTIFY is not set
CONFIG_FUSE_FS=y
CONFIG_VFAT_FS=y
CONFIG_TMPFS=y
CONFIG_NFS_FS=y
CONFIG_NFS_V3=y
CONFIG_CIFS=y
CONFIG_NLS_CODEPAGE_437=y
CONFIG_NLS_ASCII=y
CONFIG_NLS_ISO8859_1=y
CONFIG_NLS_UTF8=y
CONFIG_PRINTK_TIME=y
CONFIG_MAGIC_SYSRQ=y
CONFIG_LOCKUP_DETECTOR=y
# CONFIG_DETECT_HUNG_TASK is not set
CONFIG_SCHEDSTATS=y
CONFIG_TIMER_STATS=y
# CONFIG_DEBUG_PREEMPT is not set
CONFIG_DEBUG_INFO=y
CONFIG_DEBUG_VM=y
# CONFIG_EVENT_POWER_TRACING_DEPRECATED is not set
CONFIG_ENABLE_DEFAULT_TRACERS=y
CONFIG_DYNAMIC_DEBUG=y
CONFIG_KEYS=y
CONFIG_SECURITY=y
CONFIG_SECURITY_NETWORK=y
CONFIG_SECURITY_SELINUX=y
CONFIG_DEFAULT_SECURITY_DAC=y
CONFIG_CRYPTO_TWOFISH=y
# CONFIG_CRYPTO_ANSI_CPRNG is not set
```

## kernel/arch/arm/mach-tcc892x/Kconfig
```kconfig
if ARCH_TCC892X

comment "Machine Features"

choice
	prompt "TCC892x Chipset Type"
	default CHIP_TCC8920
	depends on ARCH_TCC892X
	help
	  Select TCC892x Chipset type.

config CHIP_TCC8920
	bool "TCC8920 Chipset"
	select DRAM_32BIT_USED
	help
	  Support for the TCC8920 Chipset. Say Y here if you
	  have such a device.

config CHIP_TCC8923
	bool "TCC8923 Chipset"
	select DRAM_32BIT_USED
	help
	  Support for the TCC8923 Chipset. Say Y here if you
	  have such a device.

config CHIP_TCC8925
	bool "TCC8925 Chipset"
	select DRAM_16BIT_USED
	help
	  Support for the TCC8925 Chipset. Say Y here if you
	  have such a device.

config CHIP_TCC8925S
	bool "TCC8925S Chipset"
	select USB_SUSPEND if PM_RUNTIME
	select DRAM_16BIT_USED
	help
	  Support for the TCC8925S Chipset. Say Y here if you
	  have such a device.
endchoice

choice
	prompt "TCC892x Board(Machine) Type"
	default MACH_TCC8920
	depends on ARCH_TCC892X
	help
	  Select TCC892x board type.

config MACH_TCC8920
	bool "TCC8920 evaluation board"
	help
	  Support for the TCC8920 evaluation board. Say Y here if you
	  have such a device.

config MACH_TCC8920ST
	bool "TCC8920 STB evaluation board"
	help
	  Support for the TCC8924 evaluation board. Say Y here if you
	  have such a device.

config MACH_M805_892X
	bool "M805S board"
	help
	  Support for the M805S board. Say Y here if you
	  have such a device.
endchoice


choice
	prompt "TCC892x STB Board"
	default STB_BOARD_EV
	depends on MACH_TCC8920ST
	help
	  Select TCC892x STB Board Type.

config STB_BOARD_EV
	bool "TCC8920 STB evalution board"
	depends on MACH_TCC8920ST
	help
	  Support for TCC8920 STB Base Board.

config STB_BOARD_HDB892S
	bool "TCC8920 HDB892S board"
	depends on MACH_TCC8920ST
	help
	  Support for TCC8920 HD892S Board.

config STB_BOARD_HDB892F
    bool "TCC8920 HDB892F board"
    depends on MACH_TCC8920ST
    help
      Support for TCC8925 HD892F Board.

config STB_BOARD_DONGLE
	bool "TCC8925 HDMI dongle board"
	depends on MACH_TCC8920ST
	help
	  Support for TCC8925 HDMI Dongle Board.

config STB_BOARD_ISDBT_MODULE
	bool "TCC8925 ISDBT Module board"
	depends on MACH_TCC8920ST
	help
	  Support for TCC8925 ISDBT Module board.

config STB_BOARD_UPC
    bool "TCC8920 UPC board"
    depends on MACH_TCC8920ST
    help
      Support for TCC8925 UPC Board.
endchoice

choice
	prompt "TCC892x MiniSTB Clock Mode"
	default HDB892X_CLOCK_NORMAL_SPEED
	depends on (STB_BOARD_HDB892S || STB_BOARD_HDB892F || STB_BOARD_UPC)
	help
	  Select the Clock Mode of TCC8925 HDMI Dongle Board.

config HDB892X_CLOCK_HIGH_SPEED
	bool "High Speed Mode"
	depends on (STB_BOARD_HDB892S || STB_BOARD_HDB892F || STB_BOARD_UPC)
	help
	  Support High Speed Mode for TCC892x HDB892x Board.

config HDB892X_CLOCK_NORMAL_SPEED
	bool "Normal Speed Mode"
	depends on (STB_BOARD_HDB892S || STB_BOARD_HDB892F || STB_BOARD_UPC)
	help
	  Support Normal Speed Mode for TCC8925 HDB892x Board.
endchoice

choice
	prompt "TCC8925 MiniSTB Custom Board"
	default HDB892F_BOARD_ORIGIN
	depends on (STB_BOARD_HDB892F)
	help
	  Select the Clock Mode of TCC8925 HDMI Dongle Board.

config HDB892F_BOARD_ORIGIN
	bool "TCC8925 Original Board"
	depends on (STB_BOARD_HDB892F)
	help
	  Support TCC8925 Original HDB892F Board.

config HDB892F_BOARD_YJ8925T
	bool "TCC8925 YJ8925T Board"
	depends on (STB_BOARD_HDB892F)
	help
	  Support TCC8925 YJ8925T Board.
endchoice

choice
	prompt "TCC892x HDMI Dongle Clock Mode"
	default HDMI_DONGLE_CLOCK_NORMAL_SPEED
	depends on HDMI_DONGLE_Double_Layer
	help
	  Select the Clock Mode of TCC8925 HDMI Dongle Board.

config HDMI_DONGLE_CLOCK_HIGH_SPEED
	bool "High Speed Mode"
	depends on HDMI_DONGLE_Double_Layer
	help
	  Support High Speed Mode for TCC8925 HDMI Dongle Board.

config HDMI_DONGLE_CLOCK_NORMAL_SPEED
	bool "Normal Speed Mode"
	depends on HDMI_DONGLE_Double_Layer
	help
	  Support Normal Speed Mode for TCC8925 HDMI Dongle Board.
endchoice

choice
	prompt "TCC892x HDMI Dongle WiFi Chip"
	default HDMI_DONGLE_WIFI_REALTEK
	depends on STB_BOARD_DONGLE
	help
	  Select WiFi Chip of TCC8925 HDMI Dongle Board.

config HDMI_DONGLE_WIFI_ARTHEROS
	bool "Artheros AR6102/6103"
	depends on STB_BOARD_DONGLE
	help
	  Support Artheros AR6102/6103 for TCC8925 HDMI Dongle Board.

config HDMI_DONGLE_WIFI_REALTEK
	bool "Realtek RTL8188/8189"
	depends on STB_BOARD_DONGLE
	help
	  Support Realtek RTL8188/8189 for TCC8925 HDMI Dongle Board.

config HDMI_DONGLE_WIFI_BROADCOM
	bool "Broadcom BCM4330"
	depends on STB_BOARD_DONGLE
	help
	  Support Broadcom BCM4330 for TCC8925 HDMI Dongle Board.
endchoice

config GPIO_CORE_VOLTAGE_CONTROL
	bool "Ctrl coreA/B voltage by gpio ports"
	depends on !REGULATOR
	default y
	help
	  Support for the TCC892X demo board.

config TCC_STB_MODE
	bool "TCC STB Mode"
        default n
	help
	  Support for the TCC93/88/8920 demo board, Say Y here if you STB
	  It change the memory configuration

config TCC_OUTPUT_STARTER
        bool "TCC OUTPUT show boot logo image on HDMI/CVBS/Component"
        depends on ARCH_TCC892X
        default n
        help
          Support for the TCC93/88/8920 demo board, Say Y here if you want
          to show boot logo by using HDMI/CVBS/Component output

config CLOCK_TABLE
	bool "Clock Table"
	depends on (ARCH_TCC892X)
	default y

config TCC_CPUFREQ_HIGHSPEED_CLOCK
	int "Rate of Highspeed CPU clock (625 ~ 833, 996)MHz (996MHz is for test)"
	range 625 996
	depends on ARCH_TCC892X
	default "833"

config HIGHSPEED_TIME_LIMIT
	bool "HighSpeed Time Limit"
	depends on ARCH_TCC892X
	default n

config HIGHSPEED_HIGHSPEED_TIME
	int "Time(sec) of Highspeed CPU clock (1-30)"
	range 1 30
	depends on HIGHSPEED_TIME_LIMIT
	default "5"

config HIGHSPEED_LIMITED_TIME
	int "Time(sec) of Limited CPU clock (1-30)"
	range 1 30
	depends on HIGHSPEED_TIME_LIMIT
	default "15"

config HIGHSPEED_LIMITED_CLOCK
	int "Rate of Time Limited CPU clock (468 ~ 808)MHz"
	range 468 808
	depends on HIGHSPEED_TIME_LIMIT
	default "625"
endif
```
