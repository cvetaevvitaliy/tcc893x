//===========================================================================
//
//                       ANDROID TRACE32 CMM FILE
//
//                        EDIT HISTORY FOR MODULE
//
//---------------------------------------------------------------------------
// version     who      history
//---------------------------------------------------------------------------
// 110407-1   Bruce     Create file
//===========================================================================

//---------------------------------------------------------------------------
// Variable
//---------------------------------------------------------------------------
global &chipset
global &smp_check

//---------------------------------------------------------------------------
// Set Environment !!
//---------------------------------------------------------------------------

&chipset="TCC893x"
&srcpath="Select location of source directory"
&debugtarget="kernel"

//----------------------------------------------------------

//CMDPOS 0.0 0.0 135. 10.

area.clear

print ""
print "==================================================="
print "      TELECHIPS TRACE32 SCRIPT for ANDROID "
print "==================================================="
print ""


//---------------------------------------------------------------------------
// DIALOG
//---------------------------------------------------------------------------
WINPOS 5. 15. 44. 12. 0. 0. W001
DIALOG
(

	HEADER "Kernel Debug Script"
	icon ":mmu"

	//-----------------------------------------------------
	// Select target..
	//-----------------------------------------------------

	POS 1. 0. 18. 1.
	DEBUG_SEL.1: choosebox "Bootloader Debugging" 
	(
		&debugtarget="bootloader"

		dialog.enable BOOTSYMBOLPATH
		dialog.enable BOOTSYMBOLBUTTON
		dialog.enable SDRAM
	)
	POS 20. 0. 15. 1.
	DEBUG_SEL.2: choosebox "Kernel Debugging" 
	(
		&debugtarget="kernel"

		dialog.disable BOOTSYMBOLPATH
		dialog.disable BOOTSYMBOLBUTTON
		dialog.disable SDRAM
	)

	//-----------------------------------------------------
	// Select chipset
	//-----------------------------------------------------
	POS 0. 1. 43. 0.
	LINE ""

	POS 1. 2. 8. 1.
	TEXT "Chipset"

	pos 13. 2. 10. 1.
	CHIPSET: PULLDOWN "TCC893x,TCC892x,TCC88xx,TCC93xx,TCC89xx,TCC92xx"
	(
		&chipset=dialog.string(CHIPSET)

		if "&chipset"=="TCC893x"
			dialog.enable SMP_CHK
		else
			dialog.disable SMP_CHK
	)

	//-----------------------------------------------------
	// SMP
	//-----------------------------------------------------
	pos 25. 2. 14. 1.
	SMP_CHK: checkbox "SMP debugging"
	(
		if dialog.boolean(SMP_CHK)
		(
			&smp_check="ON"
			print "SMP Debugging - ON"
		)
		else
		(
			&smp_check="OFF"
			print "SMP Debugging - OFF"
		)
	)

	//-----------------------------------------------------
	// KERNEL DIR
	//-----------------------------------------------------
	POS 1. 3.5 10. 1.
	TEXT "Source Directory"

	POS 13. 3.5 27. 1.
	SOURCEPATH: EDIT "Select location of source directory" ""

	POS 41. 3.5 2. 1.
	BUTTON "..."
	(
		dialog.setdir SOURCEPATH *
	)

	//-----------------------------------------------------
	// Bootloader Symbol Directory
	//-----------------------------------------------------
	POS 1. 5. 11. 1.
	TEXT "Bootloader Symbol"

	POS 13. 5. 27. 1.
	BOOTSYMBOLPATH: EDIT "Select a symbol file of the bootloader" ""

	POS 41. 5. 2. 1.
	BOOTSYMBOLBUTTON: BUTTON "..."
	(
		dialog.setfile BOOTSYMBOLPATH *
	)

	//-----------------------------------------------------
	// SDRAM
	//-----------------------------------------------------
	POS 1. 6.5 8. 1.
	TEXT "SDRAM"

	pos 13. 6.5 30. 1.
	SDRAM: PULLDOWN "TCC8935_H5TQ2G83BFRPBC_x4_2cs,TCC88xx_CT83486C1_x2,TCC88xx_HXB18T2G160AF_x2,TCC88xx_HY5PS1G1631CFPS6_x2,TCC88xx_HY5PS1G1631CFPS6_x4,TCC88xx_HY5PS1G831CFPS6_x4,TCC88xx_MT47H256M8EB25E_x4,TCC88xx_K4T1G164QE_HCF7_x4,TCC88xx_H5TQ2G63BFR_H9C_x2,TCC88xx_H5TQ2G83BFA_H9C_x4,TCC88xx_K4B1G1646E_HCH9_x2,TCC88xx_K4B2G1646C_HCK0_x2,TCC93xx_HXB18T2G160AF_x2,TCC93xx_HY5PS1G1631CFPS6_x2,TCC93xx_HY5PS1G1631CFPS6_x4,TCC93xx_HY5PS1G831CFPS6_x4,TCC93xx_H5TQ2G63BFR_H9C_x2,TCC93xx_K4B1G1646E_HCH9_x2,TCC93xx_K4B2G1646C_HCK0_x2,TCC89xx_HY5PS1G1631CFPS6_x2,TCC92xx_HY5PS1G1631CFPS6_x2,TCC892x_HY5PS1G831CFPS6_x4,TCC8930_H5TQ2G83BFRPBC_x4"
	(
		&sdram=dialog.string(SDRAM)
	)

	//-----------------------------------------------------
	// Debugging
	//-----------------------------------------------------
	POS 1. 8. 42. 2.0
	CALL_DEBUG_START: BUTTON " Debug Start "
	(
		do core\core.cmm &chipset &smp_check

		SYStem.MODE ATTACH
		if run()
			Break

		//extract debug information ..
		&srcpath=dialog.string(SOURCEPATH)
		&bootloaderpath="&srcpath"+"\bootable\bootloader\lk"
		&kernelpath="&srcpath"+"\kernel"
		&bootloadersymbol=dialog.string(BOOTSYMBOLPATH)
		&sdram=dialog.string(SDRAM)

		print "source path : &srcpath"
		print "bootloader path : &bootloaderpath"
		print "kernel path : &kernelpath"
		print "bootloader symbol : &bootloadersymbol"
		print "sdram : &sdram"
		do environment\save.cmm "chipset.sav" "srcpath.sav" "bootloadersymbol.sav" "sdram.sav"

		print "Loading Symbol .."

		if dialog.boolean(DEBUG_SEL.1)
		(
			do sdram\sdram.cmm &sdram

			Data.LOAD.Elf "&bootloadersymbol" /RELPATH /PATH &bootloaderpath /GNU /ANYSYM
			
			break.delete /ALL
			break.set kmain /onchip
		 	Go
		 	wait !run()
		 	B.d kmain

			if "&chipset"=="TCC892x"
			(
				PER.S C15:0x111 %LONG 0x3
			)

		)
		else
		(
			Data.LOAD.Elf "&kernelpath\vmlinux" /RELPATH /PATH "&kernelpath" /macro /gnu /cpp /anysym /nocode

			screen.always
	
			break.delete /ALL
		 	B.s start_kernel /onchip
		 	Go
		 	wait !run()
		 	B.d start_kernel

			if "&chipset"=="TCC892x"
			(
				PER.S C15:0x111 %LONG 0x3
			)

		 	print "Initializing Linux support..."
		 	TASK.CONFIG ~~\demo\arm\kernel\linux\linux.t32          ; loads Linux awareness (linux.t32)
		 	MENU.ReProgram ~~\demo\arm\kernel\linux\linux.men       ; loads Linux menu (linux.men)
		 	HELP.FILTER.Add rtoslinux  ; add linux awareness manual to help filter
		 	sYmbol.AutoLoad.CHECKLINUX "do "+os.ppd()+"/autoload "
		 	GROUP.Create "kernel" 0xc0000000--0xffffffff	; Group kernel area to be displayed with red bar
		)
	)

	//-----------------------------------------------------
	// jtag boot
	//-----------------------------------------------------
//	POS 1. 10. 42. 2.
//	testbt: BUTTON "jtag boot"
//	(
//		do core\core.cmm &chipset &smp_check
//
//		SYStem.MODE ATTACH
//		if run()
//			Break
//
//		//extract debug information ..
//		&srcpath=dialog.string(SOURCEPATH)
//		&bootloaderpath="&srcpath"+"\bootable\bootloader\lk"
//		&kernelpath="&srcpath"+"\kernel"
//		&bootloadersymbol=dialog.string(BOOTSYMBOLPATH)
//		&sdram=dialog.string(SDRAM)
//
//		print "source path : &srcpath"
//		print "bootloader path : &bootloaderpath"
//		print "kernel path : &kernelpath"
//		print "bootloader symbol : &bootloadersymbol"
//		print "sdram : &sdram"
//		do environment\save.cmm "chipset.sav" "srcpath.sav" "bootloadersymbol.sav" "sdram.sav"
//
//		print "Loading Symbol .."
//
//		//ddr init..
//		do sdram\sdram.cmm &sdram
//
//		//load kernel image
//		Data.LOAD.Elf "&kernelpath\vmlinux" /RELPATH /PATH "&kernelpath" /macro /gnu /cpp /anysym
//
//		//load bootloader image
//		Data.LOAD.Elf "&bootloadersymbol" /RELPATH /PATH &bootloaderpath /GNU /ANYSYM /noclear
//
//		//ramdisk
//		data.load.binary "&srcpath\out\target\product\tcc893x\ramdisk.img" 0x81000000
//
//		//load kernel symbol..
//		Data.LOAD.Elf "&kernelpath\vmlinux" /RELPATH /PATH "&kernelpath" /macro /gnu /cpp /anysym /noclear /nocode
//
//		break.delete /ALL
//	 	B.s start_kernel /onchip
//	 	Go
//	 	wait !run()
//	 	B.d start_kernel
//	)
)

dialog.set DEBUG_SEL.2
dialog.disable BOOTSYMBOLPATH
dialog.disable BOOTSYMBOLBUTTON
dialog.disable SDRAM

do environment\load.cmm "chipset.sav" "srcpath.sav" "bootloadersymbol.sav" "sdram.sav"

if "&chipset"=="TCC893x"
	dialog.enable SMP_CHK
else
	dialog.disable SMP_CHK

ENDDO
//----------------------------------------------------------



